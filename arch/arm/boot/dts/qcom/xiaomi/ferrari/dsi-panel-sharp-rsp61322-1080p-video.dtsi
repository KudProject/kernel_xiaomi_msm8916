/* Copyright (c) 2014, The Linux Foundation. All rights reserved.
 *
 * This program is free software; you can redistribute it and/or modify
 * it under the terms of the GNU General Public License version 2 and
 * only version 2 as published by the Free Software Foundation.
 *
 * This program is distributed in the hope that it will be useful,
 * but WITHOUT ANY WARRANTY; without even the implied warranty of
 * MERCHANTABILITY or FITNESS FOR A PARTICULAR PURPOSE.  See the
 * GNU General Public License for more details.
 */
/*---------------------------------------------------------------------------
 * This file is autogenerated file using gcdb parser. Please do not edit it.
 * Update input XML file to add a new entry or update variable in this file
 * VERSION = "1.0"
*---------------------------------------------------------------------------*/
&mdss_mdp {
	dsi_sharp_rsp61322_1080_vid: qcom,mdss_dsi_sharp_rsp61322_1080p_video {
		qcom,mdss-dsi-panel-name = "sharp rsp61322 1080p video mode dsi panel";
		qcom,mdss-dsi-panel-id = <0x8>;
		qcom,mdss-dsi-panel-controller = <&mdss_dsi0>;
		qcom,mdss-dsi-panel-type = "dsi_video_mode";
		qcom,mdss-dsi-panel-destination = "display_1";
		qcom,mdss-dsi-panel-framerate = <0x3c>;
		qcom,mdss-dsi-virtual-channel-id = <0x0>;
		qcom,mdss-dsi-stream = <0x0>;
		qcom,mdss-dsi-panel-width = <0x438>;
		qcom,mdss-dsi-panel-height = <0x780>;
		qcom,mdss-dsi-h-front-porch = <0x64>;
		qcom,mdss-dsi-h-back-porch = <0x32>;
		qcom,mdss-dsi-h-pulse-width = <0xa>;
		qcom,mdss-dsi-h-sync-skew = <0x0>;
		qcom,mdss-dsi-v-back-porch = <0x6>;
		qcom,mdss-dsi-v-front-porch = <0x7>;
		qcom,mdss-dsi-v-pulse-width = <0x2>;
		qcom,mdss-dsi-h-left-border = <0x0>;
		qcom,mdss-dsi-h-right-border = <0x0>;
		qcom,mdss-dsi-v-top-border = <0x0>;
		qcom,mdss-dsi-v-bottom-border = <0x0>;
		qcom,mdss-dsi-bpp = <0x18>;
		qcom,mdss-dsi-underflow-color = <0xff>;
		qcom,mdss-dsi-border-color = <0x0>;
		qcom,mdss-dsi-pixel-packing = "tight";
		qcom,mdss-dsi-pan-enable-dynamic-fps;
		qcom,mdss-dsi-pan-fps-update = "dfps_immediate_porch_mode";
		qcom,mdss-dsi-min-refresh-rate = <0x2d>;
		qcom,mdss-dsi-max-refresh-rate = <0x3c>;
		qcom,mdss-dsi-on-command = [23 01 00 00 00 00 02 b0 00 23 01 00 00 00 00 02 d6 01 29 01 00 00 10 00 19 ce 3d 40 48 56 67 78 88 98 a7 b5 c3 d1 de e9 f2 fa ff 01 5f 04 04 00 00 00 29 01 00 00 00 00 1f c7 0b 18 20 2b 3a 48 51 60 45 4d 58 65 71 73 74 09 16 1e 29 38 48 51 60 45 4d 58 65 71 75 76 29 01 00 00 00 00 14 c8 01 00 09 02 fd cf 00 00 05 fe 02 fc 00 00 0c fe f4 e8 00 23 01 00 00 00 00 02 b0 03 15 01 00 00 01 00 02 34 00 39 01 00 00 01 00 02 51 ff 15 01 00 00 01 00 02 53 2c 15 01 00 00 01 00 02 55 01 05 01 00 00 14 00 02 29 00 05 01 00 00 78 00 02 11 00];
		qcom,mdss-dsi-off-command = [05 01 00 00 14 00 02 28 00 05 01 00 00 78 00 02 10 00];
		qcom,mdss-dsi-on-command-state = "dsi_lp_mode";
		qcom,mdss-dsi-off-command-state = "dsi_lp_mode";
		qcom,mdss-dsi-h-sync-pulse = <0x0>;
		qcom,mdss-dsi-traffic-mode = "non_burst_sync_pulse";
		qcom,mdss-dsi-bllp-eof-power-mode;
		qcom,mdss-dsi-bllp-power-mode;
		qcom,mdss-dsi-lane-0-state;
		qcom,mdss-dsi-lane-1-state;
		qcom,mdss-dsi-lane-2-state;
		qcom,mdss-dsi-lane-3-state;
		qcom,mdss-dsi-lp11-init;
		qcom,mdss-dsi-panel-timings = <0xe04a3600 0xa9aa2b4e 0x3c030400>;
		qcom,mdss-dsi-t-clk-post = <0x19>;
		qcom,mdss-dsi-t-clk-pre = <0x2f>;
		qcom,mdss-dsi-bl-min-level = <0x1>;
		qcom,mdss-dsi-bl-max-level = <0xff>;
		qcom,mdss-dsi-dma-trigger = "trigger_sw";
		qcom,mdss-dsi-mdp-trigger = "none";
		qcom,mdss-dsi-bl-pmic-control-type = "bl_ctrl_sic";
		qcom,mdss-dsi-reset-sequence = <0x1 0x5 0x0 0xa 0x1 0xa>;
		qcom,mdss-pan-physical-width-dimension = <0x3d>;
		qcom,mdss-pan-physical-height-dimension = <0x6d>;
		qcom,cont-splash-enabled;
		qcom,dispparam-enabled;
		qcom,mdss-dsi-dispparam-ceon-command = [23 01 00 00 00 00 02 b0 00 29 01 00 00 00 00 21 ca 01 80 82 98 b0 9c 90 90 14 30 00 80 0a 42 44 80 69 da 08 08 08 06 08 04 00 00 10 10 3f 3f 3f 3f 23 01 00 00 00 00 02 d6 01 23 01 00 00 00 00 02 b0 03];
		qcom,mdss-dsi-dispparam-ceon-command-state = "dsi_hs_mode";
		qcom,mdss-dsi-dispparam-ceoff-command = [23 01 00 00 00 00 02 b0 00 29 01 00 00 00 00 21 ca 00 80 82 98 b0 9c 90 90 14 30 00 80 0a 42 44 80 69 da 08 08 08 06 08 04 00 00 10 10 3f 3f 3f 3f 23 01 00 00 00 00 02 d6 01 23 01 00 00 00 00 02 b0 03];
		qcom,mdss-dsi-dispparam-ceoff-command-state = "dsi_hs_mode";
		qcom,mdss-dsi-dispparam-warm-command = <0x29010000 0x2b0 0x290100 0x1f 0xc70c1921 0x2c3b4851 0x60454d58 0x65717273 0x8151d28 0x37485160 0x454d5865 0x71767729 0x1000000 0x14c801 0xb02fe 0xec000005 0xfd02fc00 0xd00f7 0xbb002901 0x0 0x2d60129 0x1000000 0x2b003>;
		qcom,mdss-dsi-dispparam-warm-command-state = "dsi_hs_mode";
		qcom,mdss-dsi-dispparam-default-command = <0x29010000 0x2b0 0x290100 0x1f 0xc70b1820 0x2b3a4851 0x60454d58 0x65717374 0x9161e29 0x38485160 0x454d5865 0x71757629 0x1000000 0x14c801 0x902fd 0xcf000005 0xfe02fc00 0xcfef4 0xe8002901 0x0 0x2d60129 0x1000000 0x2b003>;
		qcom,mdss-dsi-dispparam-default-command-state = "dsi_hs_mode";
		qcom,mdss-dsi-dispparam-cold-command = <0x29010000 0x2b0 0x290100 0x1f 0xc70c1922 0x2d3d4953 0x6348505c 0x6b727374 0x8151e29 0x39495363 0x48505c6b 0x74757629 0x1000000 0x14c801 0x11f705f6 0xa10011f3 0xf8e700 0x11fafeec 0xfc002901 0x0 0x2d60129 0x1000000 0x2b003>;
		qcom,mdss-dsi-dispparam-cold-command-state = "dsi_hs_mode";
		qcom,mdss-dsi-dispparam-cabcon-command_GUI = [39 01 00 00 00 00 02 55 01];
		qcom,mdss-dsi-dispparam-cabcon-command_STILL = [15 01 00 00 10 00 02 55 02];
		qcom,mdss-dsi-dispparam-cabcon-command_MOVIE = [15 01 00 00 10 00 02 55 03];
		qcom,mdss-dsi-dispparam-cabcon-command-state = "dsi_hs_mode";
		qcom,mdss-dsi-dispparam-cabcoff-command = [39 01 00 00 00 00 02 55 00];
		qcom,mdss-dsi-dispparam-cabcoff-command-state = "dsi_hs_mode";
	};
};
