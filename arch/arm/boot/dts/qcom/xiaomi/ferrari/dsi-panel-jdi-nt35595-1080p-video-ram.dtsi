/* Copyright (c) 2014, The Linux Foundation. All rights reserved.
 *
 * This program is free software; you can redistribute it and/or modify
 * it under the terms of the GNU General Public License version 2 and
 * only version 2 as published by the Free Software Foundation.
 *
 * This program is distributed in the hope that it will be useful,
 * but WITHOUT ANY WARRANTY; without even the implied warranty of
 * MERCHANTABILITY or FITNESS FOR A PARTICULAR PURPOSE.  See the
 * GNU General Public License for more details.
 */
/*---------------------------------------------------------------------------
 * This file is autogenerated file using gcdb parser. Please do not edit it.
 * Update input XML file to add a new entry or update variable in this file
 * VERSION = "1.0"
*---------------------------------------------------------------------------*/
&mdss_mdp {
	dsi_jdi_nt35595_1080_vid: qcom,mdss_dsi_jdi_nt35595_1080p_video {
		qcom,mdss-dsi-panel-name = "jdi nt35595 1080p video mode dsi panel";
		qcom,mdss-dsi-panel-id = <0x0>;
		qcom,mdss-dsi-panel-controller = <&mdss_dsi0>;
		qcom,mdss-dsi-panel-type = "dsi_video_mode";
		qcom,mdss-dsi-panel-destination = "display_1";
		qcom,mdss-dsi-panel-framerate = <0x3c>;
		qcom,mdss-dsi-virtual-channel-id = <0x0>;
		qcom,mdss-dsi-stream = <0x0>;
		qcom,mdss-dsi-panel-width = <0x438>;
		qcom,mdss-dsi-panel-height = <0x780>;
		qcom,mdss-dsi-h-front-porch = <0x58>;
		qcom,mdss-dsi-h-back-porch = <0x18>;
		qcom,mdss-dsi-h-pulse-width = <0x8>;
		qcom,mdss-dsi-h-sync-skew = <0x0>;
		qcom,mdss-dsi-v-back-porch = <0x3>;
		qcom,mdss-dsi-v-front-porch = <0x4>;
		qcom,mdss-dsi-v-pulse-width = <0x2>;
		qcom,mdss-dsi-h-left-border = <0x0>;
		qcom,mdss-dsi-h-right-border = <0x0>;
		qcom,mdss-dsi-v-top-border = <0x0>;
		qcom,mdss-dsi-v-bottom-border = <0x0>;
		qcom,mdss-dsi-bpp = <0x18>;
		qcom,mdss-dsi-underflow-color = <0xff>;
		qcom,mdss-dsi-border-color = <0x0>;
		qcom,mdss-dsi-pixel-packing = "tight";
		qcom,mdss-dsi-pan-enable-dynamic-fps;
		qcom,mdss-dsi-pan-fps-update = "dfps_immediate_porch_mode";
		qcom,mdss-dsi-min-refresh-rate = <0x2d>;
		qcom,mdss-dsi-max-refresh-rate = <0x3c>;
		qcom,mdss-dsi-on-command = <0x15000000 0x10002ff 0xf0150000 0x10002 0x13011500 0x100 0x2fb0115 0x1000001 0x2ff22 0x15000000 0x10002fb 0x1150000 0x10002 0x1a001500 0x100 0x2530215 0x1000001 0x25401 0x15000000 0x1000256 0x150000 0x10002 0x68001500 0x100 0x2ff1015 0x1 0x2bb03 0x39000000 0x100063b 0x3040410 0x10150000 0x10002 0x50001501 0x100 0x2340015 0x1 0x251ff 0x15000000 0x1000253 0x2c150000 0x10002 0x55810501 0x7800 0x2110005 0x1000014 0x22900>;
		qcom,mdss-dsi-off-command = <0x15010000 0x2ff 0x10390100 0x320002 0x28003901 0x6400 0x2100015 0x1000009 0x24f01>;
		qcom,mdss-dsi-on-command-state = "dsi_lp_mode";
		qcom,mdss-dsi-off-command-state = "dsi_lp_mode";
		qcom,mdss-dsi-h-sync-pulse = <0x0>;
		qcom,mdss-dsi-traffic-mode = "non_burst_sync_pulse";
		qcom,mdss-dsi-bllp-eof-power-mode;
		qcom,mdss-dsi-bllp-power-mode;
		qcom,mdss-dsi-lane-0-state;
		qcom,mdss-dsi-lane-1-state;
		qcom,mdss-dsi-lane-2-state;
		qcom,mdss-dsi-lane-3-state;
		qcom,mdss-dsi-lp11-init;
		qcom,mdss-dsi-panel-timings = <0xe04a3600 0xa9aa2b4e 0x3c030400>;
		qcom,mdss-dsi-t-clk-post = <0x19>;
		qcom,mdss-dsi-t-clk-pre = <0x2f>;
		qcom,mdss-dsi-bl-min-level = <0x1>;
		qcom,mdss-dsi-bl-max-level = <0xff>;
		qcom,mdss-dsi-dma-trigger = "trigger_sw";
		qcom,mdss-dsi-mdp-trigger = "none";
		qcom,mdss-dsi-bl-pmic-control-type = "bl_ctrl_sic";
		qcom,mdss-dsi-reset-sequence = <0x1 0xf 0x0 0x5 0x1 0xa>;
		qcom,mdss-pan-physical-width-dimension = <0x3d>;
		qcom,mdss-pan-physical-height-dimension = <0x6d>;
		qcom,cont-splash-enabled;
		qcom,dispparam-enabled;
		qcom,mdss-dsi-dispparam-ceon-command = [15 01 00 00 01 00 02 ff 22 15 00 00 00 01 00 02 00 28 15 00 00 00 01 00 02 01 2c 15 00 00 00 01 00 02 02 30 15 00 00 00 01 00 02 03 34 15 00 00 00 01 00 02 04 38 15 00 00 00 01 00 02 05 3c 15 00 00 00 01 00 02 06 40 15 00 00 00 01 00 02 07 48 15 00 00 00 01 00 02 08 4c 15 00 00 00 01 00 02 09 50 15 00 00 00 01 00 02 0a 58 15 00 00 00 01 00 02 0b 60 15 00 00 00 01 00 02 0c 60 15 00 00 00 01 00 02 0d 58 15 00 00 00 01 00 02 0e 50 15 00 00 00 01 00 02 0f 48 15 00 00 00 01 00 02 10 38 15 00 00 00 01 00 02 11 28 15 01 00 00 01 00 02 12 28 15 00 00 00 01 00 02 13 28 15 00 00 00 01 00 02 1b 00 15 00 00 00 01 00 02 1c 00 15 00 00 00 01 00 02 1d 00 15 00 00 00 01 00 02 1e 00 15 00 00 00 01 00 02 1f 00 15 00 00 00 01 00 02 20 00 15 00 00 00 01 00 02 21 00 15 00 00 00 01 00 02 22 00 15 00 00 00 01 00 02 23 00 15 00 00 00 01 00 02 24 00 15 00 00 00 01 00 02 25 00 15 00 00 00 01 00 02 26 00 15 00 00 00 01 00 02 27 00 15 00 00 00 01 00 02 28 00 15 00 00 00 01 00 02 29 00 15 00 00 00 01 00 02 2a 00 15 00 00 00 01 00 02 2b 00 15 00 00 00 01 00 02 2f 00 15 00 00 00 01 00 02 30 00 15 00 00 00 01 00 02 31 00 15 00 00 00 01 00 02 32 80 15 00 00 00 01 00 02 33 80 15 00 00 00 01 00 02 34 80 15 00 00 00 01 00 02 35 82 15 00 00 00 01 00 02 36 84 15 00 00 00 01 00 02 37 86 15 00 00 00 01 00 02 38 88 15 00 00 00 01 00 02 39 8a 15 00 00 00 01 00 02 3a 8c 15 01 00 00 01 00 02 3b 8e 15 00 00 00 01 00 02 3f 90 15 00 00 00 01 00 02 40 92 15 00 00 00 01 00 02 41 94 15 00 00 00 01 00 02 42 94 15 00 00 00 01 00 02 43 92 15 00 00 00 01 00 02 44 90 15 00 00 00 01 00 02 45 8e 15 00 00 00 01 00 02 46 8c 15 00 00 00 01 00 02 47 8a 15 00 00 00 01 00 02 48 88 15 00 00 00 01 00 02 49 86 15 00 00 00 01 00 02 4a 84 15 00 00 00 01 00 02 4b 82 15 00 00 00 01 00 02 4c 80 15 00 00 00 01 00 02 4d 08 15 00 00 00 01 00 02 53 03 15 00 00 00 01 00 02 54 00 15 00 00 00 01 00 02 fb 01 15 01 00 00 01 00 02 ff 10];
		qcom,mdss-dsi-dispparam-ceon-command-state = "dsi_hs_mode";
		qcom,mdss-dsi-dispparam-ceoff-command = <0x15010000 0x100002ff 0x22150000 0x100002 0xfb011500 0x1000 0x2540115 0x1000001 0x2ff10>;
		qcom,mdss-dsi-dispparam-ceoff-command-state = "dsi_hs_mode";
		qcom,mdss-dsi-dispparam-warm-command = [15 01 00 00 01 00 02 ff 20 15 00 00 00 01 00 02 75 00 15 00 00 00 01 00 02 76 00 15 00 00 00 01 00 02 77 00 15 00 00 00 01 00 02 78 0b 15 00 00 00 01 00 02 79 00 15 00 00 00 01 00 02 7a 23 15 00 00 00 01 00 02 7b 00 15 00 00 00 01 00 02 7c 36 15 00 00 00 01 00 02 7d 00 15 00 00 00 01 00 02 7e 4a 15 00 00 00 01 00 02 7f 00 15 00 00 00 01 00 02 80 5b 15 00 00 00 01 00 02 81 00 15 00 00 00 01 00 02 82 6c 15 00 00 00 01 00 02 83 00 15 00 00 00 01 00 02 84 7a 15 00 00 00 01 00 02 85 00 15 00 00 00 01 00 02 86 88 15 00 00 00 01 00 02 87 00 15 00 00 00 01 00 02 88 ba 15 00 00 00 01 00 02 89 00 15 00 00 00 01 00 02 8a e4 15 00 00 00 01 00 02 8b 01 15 00 00 00 01 00 02 8c 2a 15 00 00 00 01 00 02 8d 01 15 00 00 00 01 00 02 8e 5f 15 00 00 00 01 00 02 8f 01 15 00 00 00 01 00 02 90 a9 15 00 00 00 01 00 02 91 01 15 00 00 00 01 00 02 92 e8 15 00 00 00 01 00 02 93 01 15 00 00 00 01 00 02 94 ea 15 00 00 00 01 00 02 95 02 15 00 00 00 01 00 02 96 22 15 00 00 00 01 00 02 97 02 15 00 00 00 01 00 02 98 61 15 00 00 00 01 00 02 99 02 15 00 00 00 01 00 02 9a 89 15 00 00 00 01 00 02 9b 02 15 00 00 00 01 00 02 9c c4 15 00 00 00 01 00 02 9d 02 15 00 00 00 01 00 02 9e f0 15 00 00 00 01 00 02 9f 03 15 00 00 00 01 00 02 a0 30 15 00 00 00 01 00 02 a2 03 15 00 00 00 01 00 02 a3 44 15 00 00 00 01 00 02 a4 03 15 00 00 00 01 00 02 a5 5a 15 00 00 00 01 00 02 a6 03 15 00 00 00 01 00 02 a7 73 15 00 00 00 01 00 02 a9 03 15 00 00 00 01 00 02 aa 8d 15 00 00 00 01 00 02 ab 03 15 00 00 00 01 00 02 ac aa 15 00 00 00 01 00 02 ad 03 15 00 00 00 01 00 02 ae ca 15 00 00 00 01 00 02 af 03 15 00 00 00 01 00 02 b0 ee 15 00 00 00 01 00 02 b1 03 15 01 00 00 01 00 02 b2 ff 15 00 00 00 01 00 02 b3 00 15 00 00 00 01 00 02 b4 4a 15 00 00 00 01 00 02 b5 00 15 00 00 00 01 00 02 b6 54 15 00 00 00 01 00 02 b7 00 15 00 00 00 01 00 02 b8 69 15 00 00 00 01 00 02 b9 00 15 00 00 00 01 00 02 ba 7a 15 00 00 00 01 00 02 bb 00 15 00 00 00 01 00 02 bc 8b 15 00 00 00 01 00 02 bd 00 15 00 00 00 01 00 02 be 99 15 00 00 00 01 00 02 bf 00 15 00 00 00 01 00 02 c0 a7 15 00 00 00 01 00 02 c1 00 15 00 00 00 01 00 02 c2 b3 15 00 00 00 01 00 02 c3 00 15 00 00 00 01 00 02 c4 be 15 00 00 00 01 00 02 c5 00 15 00 00 00 01 00 02 c6 e5 15 00 00 00 01 00 02 c7 01 15 00 00 00 01 00 02 c8 04 15 00 00 00 01 00 02 c9 01 15 00 00 00 01 00 02 ca 34 15 00 00 00 01 00 02 cb 01 15 00 00 00 01 00 02 cc 5f 15 00 00 00 01 00 02 cd 01 15 00 00 00 01 00 02 ce a9 15 00 00 00 01 00 02 cf 01 15 00 00 00 01 00 02 d0 e8 15 00 00 00 01 00 02 d1 01 15 00 00 00 01 00 02 d2 ea 15 00 00 00 01 00 02 d3 02 15 00 00 00 01 00 02 d4 22 15 00 00 00 01 00 02 d5 02 15 00 00 00 01 00 02 d6 61 15 00 00 00 01 00 02 d7 02 15 00 00 00 01 00 02 d8 89 15 00 00 00 01 00 02 d9 02 15 00 00 00 01 00 02 da c4 15 00 00 00 01 00 02 db 02 15 00 00 00 01 00 02 dc f0 15 00 00 00 01 00 02 dd 03 15 00 00 00 01 00 02 de 30 15 00 00 00 01 00 02 df 03 15 00 00 00 01 00 02 e0 44 15 00 00 00 01 00 02 e1 03 15 00 00 00 01 00 02 e2 5a 15 00 00 00 01 00 02 e3 03 15 00 00 00 01 00 02 e4 73 15 00 00 00 01 00 02 e5 03 15 00 00 00 01 00 02 e6 8d 15 00 00 00 01 00 02 e7 03 15 00 00 00 01 00 02 e8 aa 15 00 00 00 01 00 02 e9 03 15 00 00 00 01 00 02 ea ca 15 00 00 00 01 00 02 eb 03 15 00 00 00 01 00 02 ec ee 15 00 00 00 01 00 02 ed 03 15 01 00 00 01 00 02 ee ff 15 00 00 00 01 00 02 ef 00 15 00 00 00 01 00 02 f0 91 15 00 00 00 01 00 02 f1 00 15 00 00 00 01 00 02 f2 97 15 00 00 00 01 00 02 f3 00 15 00 00 00 01 00 02 f4 a3 15 00 00 00 01 00 02 f5 00 15 00 00 00 01 00 02 f6 ac 15 00 00 00 01 00 02 f7 00 15 00 00 00 01 00 02 f8 b7 15 00 00 00 01 00 02 f9 00 15 00 00 00 01 00 02 fa c1 15 00 00 00 01 00 02 fb 01 15 01 00 00 01 00 02 ff 21 15 00 00 00 01 00 02 00 00 15 00 00 00 01 00 02 01 cb 15 00 00 00 01 00 02 02 00 15 00 00 00 01 00 02 03 d4 15 00 00 00 01 00 02 04 00 15 00 00 00 01 00 02 05 dd 15 00 00 00 01 00 02 06 00 15 00 00 00 01 00 02 07 ff 15 00 00 00 01 00 02 08 01 15 00 00 00 01 00 02 09 1d 15 00 00 00 01 00 02 0a 01 15 00 00 00 01 00 02 0b 53 15 00 00 00 01 00 02 0c 01 15 00 00 00 01 00 02 0d 7e 15 00 00 00 01 00 02 0e 01 15 00 00 00 01 00 02 0f be 15 00 00 00 01 00 02 10 01 15 00 00 00 01 00 02 11 f5 15 00 00 00 01 00 02 12 01 15 00 00 00 01 00 02 13 f7 15 00 00 00 01 00 02 14 02 15 00 00 00 01 00 02 15 2b 15 00 00 00 01 00 02 16 02 15 00 00 00 01 00 02 17 68 15 00 00 00 01 00 02 18 02 15 00 00 00 01 00 02 19 91 15 00 00 00 01 00 02 1a 02 15 00 00 00 01 00 02 1b cb 15 00 00 00 01 00 02 1c 02 15 00 00 00 01 00 02 1d f5 15 00 00 00 01 00 02 1e 03 15 00 00 00 01 00 02 1f 36 15 00 00 00 01 00 02 20 03 15 00 00 00 01 00 02 21 49 15 00 00 00 01 00 02 22 03 15 00 00 00 01 00 02 23 5f 15 00 00 00 01 00 02 24 03 15 00 00 00 01 00 02 25 76 15 00 00 00 01 00 02 26 03 15 00 00 00 01 00 02 27 90 15 00 00 00 01 00 02 28 03 15 00 00 00 01 00 02 29 ac 15 00 00 00 01 00 02 2a 03 15 00 00 00 01 00 02 2b cb 15 00 00 00 01 00 02 2d 03 15 00 00 00 01 00 02 2f ee 15 00 00 00 01 00 02 30 03 15 01 00 00 01 00 02 31 ff 15 00 00 00 01 00 02 32 00 15 00 00 00 01 00 02 33 d0 15 00 00 00 01 00 02 34 00 15 00 00 00 01 00 02 35 d4 15 00 00 00 01 00 02 36 00 15 00 00 00 01 00 02 37 de 15 00 00 00 01 00 02 38 00 15 00 00 00 01 00 02 39 e5 15 00 00 00 01 00 02 3a 00 15 00 00 00 01 00 02 3b ee 15 00 00 00 01 00 02 3d 00 15 00 00 00 01 00 02 3f f5 15 00 00 00 01 00 02 40 00 15 00 00 00 01 00 02 41 fd 15 00 00 00 01 00 02 42 01 15 00 00 00 01 00 02 43 04 15 00 00 00 01 00 02 44 01 15 00 00 00 01 00 02 45 0b 15 00 00 00 01 00 02 46 01 15 00 00 00 01 00 02 47 23 15 00 00 00 01 00 02 48 01 15 00 00 00 01 00 02 49 39 15 00 00 00 01 00 02 4a 01 15 00 00 00 01 00 02 4b 5c 15 00 00 00 01 00 02 4c 01 15 00 00 00 01 00 02 4d 7e 15 00 00 00 01 00 02 4e 01 15 00 00 00 01 00 02 4f be 15 00 00 00 01 00 02 50 01 15 00 00 00 01 00 02 51 f5 15 00 00 00 01 00 02 52 01 15 00 00 00 01 00 02 53 f7 15 00 00 00 01 00 02 54 02 15 00 00 00 01 00 02 55 2b 15 00 00 00 01 00 02 56 02 15 00 00 00 01 00 02 58 68 15 00 00 00 01 00 02 59 02 15 00 00 00 01 00 02 5a 91 15 00 00 00 01 00 02 5b 02 15 00 00 00 01 00 02 5c cb 15 00 00 00 01 00 02 5d 02 15 00 00 00 01 00 02 5e f5 15 00 00 00 01 00 02 5f 03 15 00 00 00 01 00 02 60 36 15 00 00 00 01 00 02 61 03 15 00 00 00 01 00 02 62 49 15 00 00 00 01 00 02 63 03 15 00 00 00 01 00 02 64 5f 15 00 00 00 01 00 02 65 03 15 00 00 00 01 00 02 66 76 15 00 00 00 01 00 02 67 03 15 00 00 00 01 00 02 68 90 15 00 00 00 01 00 02 69 03 15 00 00 00 01 00 02 6a ac 15 00 00 00 01 00 02 6b 03 15 00 00 00 01 00 02 6c cb 15 00 00 00 01 00 02 6d 03 15 00 00 00 01 00 02 6e ee 15 00 00 00 01 00 02 6f 03 15 01 00 00 01 00 02 70 ff 15 00 00 00 01 00 02 71 00 15 00 00 00 01 00 02 72 d6 15 00 00 00 01 00 02 73 00 15 00 00 00 01 00 02 74 d9 15 00 00 00 01 00 02 75 00 15 00 00 00 01 00 02 76 e2 15 00 00 00 01 00 02 77 00 15 00 00 00 01 00 02 78 ea 15 00 00 00 01 00 02 79 00 15 00 00 00 01 00 02 7a f0 15 00 00 00 01 00 02 7b 00 15 00 00 00 01 00 02 7c f8 15 00 00 00 01 00 02 7d 01 15 00 00 00 01 00 02 7e 00 15 00 00 00 01 00 02 7f 01 15 00 00 00 01 00 02 80 07 15 00 00 00 01 00 02 81 01 15 00 00 00 01 00 02 82 0e 15 00 00 00 01 00 02 83 01 15 00 00 00 01 00 02 84 29 15 00 00 00 01 00 02 85 01 15 00 00 00 01 00 02 86 42 15 00 00 00 01 00 02 87 01 15 00 00 00 01 00 02 88 6f 15 00 00 00 01 00 02 89 01 15 00 00 00 01 00 02 8a 94 15 00 00 00 01 00 02 8b 01 15 00 00 00 01 00 02 8c cd 15 00 00 00 01 00 02 8d 02 15 00 00 00 01 00 02 8e 00 15 00 00 00 01 00 02 8f 02 15 00 00 00 01 00 02 90 02 15 00 00 00 01 00 02 91 02 15 00 00 00 01 00 02 92 33 15 00 00 00 01 00 02 93 02 15 00 00 00 01 00 02 94 70 15 00 00 00 01 00 02 95 02 15 00 00 00 01 00 02 96 98 15 00 00 00 01 00 02 97 02 15 00 00 00 01 00 02 98 d8 15 00 00 00 01 00 02 99 03 15 00 00 00 01 00 02 9a 03 15 00 00 00 01 00 02 9b 03 15 00 00 00 01 00 02 9c 2d 15 00 00 00 01 00 02 9d 03 15 00 00 00 01 00 02 9e 40 15 00 00 00 01 00 02 9f 03 15 00 00 00 01 00 02 a0 56 15 00 00 00 01 00 02 a2 03 15 00 00 00 01 00 02 a3 6e 15 00 00 00 01 00 02 a4 03 15 00 00 00 01 00 02 a5 88 15 00 00 00 01 00 02 a6 03 15 00 00 00 01 00 02 a7 a6 15 00 00 00 01 00 02 a9 03 15 00 00 00 01 00 02 aa c7 15 00 00 00 01 00 02 ab 03 15 00 00 00 01 00 02 ac ed 15 00 00 00 01 00 02 ad 03 15 01 00 00 01 00 02 ae ff 15 00 00 00 01 00 02 af 01 15 00 00 00 01 00 02 b0 0d 15 00 00 00 01 00 02 b1 01 15 00 00 00 01 00 02 b2 0f 15 00 00 00 01 00 02 b3 01 15 00 00 00 01 00 02 b4 16 15 00 00 00 01 00 02 b5 01 15 00 00 00 01 00 02 b6 1c 15 00 00 00 01 00 02 b7 01 15 00 00 00 01 00 02 b8 21 15 00 00 00 01 00 02 b9 01 15 00 00 00 01 00 02 ba 26 15 00 00 00 01 00 02 bb 01 15 00 00 00 01 00 02 bc 2c 15 00 00 00 01 00 02 bd 01 15 00 00 00 01 00 02 be 31 15 00 00 00 01 00 02 bf 01 15 00 00 00 01 00 02 c0 37 15 00 00 00 01 00 02 c1 01 15 00 00 00 01 00 02 c2 49 15 00 00 00 01 00 02 c3 01 15 00 00 00 01 00 02 c4 5a 15 00 00 00 01 00 02 c5 01 15 00 00 00 01 00 02 c6 77 15 00 00 00 01 00 02 c7 01 15 00 00 00 01 00 02 c8 94 15 00 00 00 01 00 02 c9 01 15 00 00 00 01 00 02 ca cd 15 00 00 00 01 00 02 cb 02 15 00 00 00 01 00 02 cc 00 15 00 00 00 01 00 02 cd 02 15 00 00 00 01 00 02 ce 02 15 00 00 00 01 00 02 cf 02 15 00 00 00 01 00 02 d0 33 15 00 00 00 01 00 02 d1 02 15 00 00 00 01 00 02 d2 70 15 00 00 00 01 00 02 d3 02 15 00 00 00 01 00 02 d4 98 15 00 00 00 01 00 02 d5 02 15 00 00 00 01 00 02 d6 d8 15 00 00 00 01 00 02 d7 03 15 00 00 00 01 00 02 d8 03 15 00 00 00 01 00 02 d9 03 15 00 00 00 01 00 02 da 2d 15 00 00 00 01 00 02 db 03 15 00 00 00 01 00 02 dc 40 15 00 00 00 01 00 02 dd 03 15 00 00 00 01 00 02 de 56 15 00 00 00 01 00 02 df 03 15 00 00 00 01 00 02 e0 6e 15 00 00 00 01 00 02 e1 03 15 00 00 00 01 00 02 e2 88 15 00 00 00 01 00 02 e3 03 15 00 00 00 01 00 02 e4 a6 15 00 00 00 01 00 02 e5 03 15 00 00 00 01 00 02 e6 c7 15 00 00 00 01 00 02 e7 03 15 00 00 00 01 00 02 e8 ed 15 00 00 00 01 00 02 e9 03 15 01 00 00 01 00 02 ea ff 15 00 00 00 01 00 02 eb 30 15 00 00 00 01 00 02 ec 17 15 00 00 00 01 00 02 ed 20 15 00 00 00 01 00 02 ee 0f 15 00 00 00 01 00 02 ef 1f 15 00 00 00 01 00 02 f0 0f 15 00 00 00 01 00 02 f1 0f 15 00 00 00 01 00 02 f2 07 15 00 00 00 01 00 02 fb 01 15 01 00 00 01 00 02 ff 10];
		qcom,mdss-dsi-dispparam-warm-command-state = "dsi_hs_mode";
		qcom,mdss-dsi-dispparam-default-command = [15 01 00 00 01 00 02 ff 20 15 00 00 00 01 00 02 fb 00 15 01 00 00 01 00 02 ff 21 15 00 00 00 01 00 02 fb 00 15 01 00 00 01 00 02 ff 10 05 01 00 00 10 00 02 11 00];
		qcom,mdss-dsi-dispparam-default-command-state = "dsi_hs_mode";
		qcom,mdss-dsi-dispparam-cold-command = [15 01 00 00 01 00 02 ff 20 15 00 00 00 01 00 02 75 00 15 00 00 00 01 00 02 76 32 15 00 00 00 01 00 02 77 00 15 00 00 00 01 00 02 78 3c 15 00 00 00 01 00 02 79 00 15 00 00 00 01 00 02 7a 50 15 00 00 00 01 00 02 7b 00 15 00 00 00 01 00 02 7c 61 15 00 00 00 01 00 02 7d 00 15 00 00 00 01 00 02 7e 72 15 00 00 00 01 00 02 7f 00 15 00 00 00 01 00 02 80 81 15 00 00 00 01 00 02 81 00 15 00 00 00 01 00 02 82 8f 15 00 00 00 01 00 02 83 00 15 00 00 00 01 00 02 84 9d 15 00 00 00 01 00 02 85 00 15 00 00 00 01 00 02 86 aa 15 00 00 00 01 00 02 87 00 15 00 00 00 01 00 02 88 d8 15 00 00 00 01 00 02 89 00 15 00 00 00 01 00 02 8a ff 15 00 00 00 01 00 02 8b 01 15 00 00 00 01 00 02 8c 43 15 00 00 00 01 00 02 8d 01 15 00 00 00 01 00 02 8e 74 15 00 00 00 01 00 02 8f 01 15 00 00 00 01 00 02 90 bd 15 00 00 00 01 00 02 91 01 15 00 00 00 01 00 02 92 f8 15 00 00 00 01 00 02 93 01 15 00 00 00 01 00 02 94 f9 15 00 00 00 01 00 02 95 02 15 00 00 00 01 00 02 96 31 15 00 00 00 01 00 02 97 02 15 00 00 00 01 00 02 98 72 15 00 00 00 01 00 02 99 02 15 00 00 00 01 00 02 9a a0 15 00 00 00 01 00 02 9b 02 15 00 00 00 01 00 02 9c dd 15 00 00 00 01 00 02 9d 03 15 00 00 00 01 00 02 9e 08 15 00 00 00 01 00 02 9f 03 15 00 00 00 01 00 02 a0 46 15 00 00 00 01 00 02 a2 03 15 00 00 00 01 00 02 a3 58 15 00 00 00 01 00 02 a4 03 15 00 00 00 01 00 02 a5 6d 15 00 00 00 01 00 02 a6 03 15 00 00 00 01 00 02 a7 83 15 00 00 00 01 00 02 a9 03 15 00 00 00 01 00 02 aa 9a 15 00 00 00 01 00 02 ab 03 15 00 00 00 01 00 02 ac b4 15 00 00 00 01 00 02 ad 03 15 00 00 00 01 00 02 ae d1 15 00 00 00 01 00 02 af 03 15 00 00 00 01 00 02 b0 f0 15 00 00 00 01 00 02 b1 03 15 01 00 00 01 00 02 b2 ff 15 00 00 00 01 00 02 b3 00 15 00 00 00 01 00 02 b4 79 15 00 00 00 01 00 02 b5 00 15 00 00 00 01 00 02 b6 82 15 00 00 00 01 00 02 b7 00 15 00 00 00 01 00 02 b8 93 15 00 00 00 01 00 02 b9 00 15 00 00 00 01 00 02 ba a2 15 00 00 00 01 00 02 bb 00 15 00 00 00 01 00 02 bc b0 15 00 00 00 01 00 02 bd 00 15 00 00 00 01 00 02 be bc 15 00 00 00 01 00 02 bf 00 15 00 00 00 01 00 02 c0 c7 15 00 00 00 01 00 02 c1 00 15 00 00 00 01 00 02 c2 d4 15 00 00 00 01 00 02 c3 00 15 00 00 00 01 00 02 c4 de 15 00 00 00 01 00 02 c5 01 15 00 00 00 01 00 02 c6 01 15 00 00 00 01 00 02 c7 01 15 00 00 00 01 00 02 c8 1e 15 00 00 00 01 00 02 c9 01 15 00 00 00 01 00 02 ca 4d 15 00 00 00 01 00 02 cb 01 15 00 00 00 01 00 02 cc 74 15 00 00 00 01 00 02 cd 01 15 00 00 00 01 00 02 ce bd 15 00 00 00 01 00 02 cf 01 15 00 00 00 01 00 02 d0 f8 15 00 00 00 01 00 02 d1 01 15 00 00 00 01 00 02 d2 f9 15 00 00 00 01 00 02 d3 02 15 00 00 00 01 00 02 d4 31 15 00 00 00 01 00 02 d5 02 15 00 00 00 01 00 02 d6 72 15 00 00 00 01 00 02 d7 02 15 00 00 00 01 00 02 d8 a0 15 00 00 00 01 00 02 d9 02 15 00 00 00 01 00 02 da dd 15 00 00 00 01 00 02 db 03 15 00 00 00 01 00 02 dc 08 15 00 00 00 01 00 02 dd 03 15 00 00 00 01 00 02 de 46 15 00 00 00 01 00 02 df 03 15 00 00 00 01 00 02 e0 58 15 00 00 00 01 00 02 e1 03 15 00 00 00 01 00 02 e2 6d 15 00 00 00 01 00 02 e3 03 15 00 00 00 01 00 02 e4 83 15 00 00 00 01 00 02 e5 03 15 00 00 00 01 00 02 e6 9a 15 00 00 00 01 00 02 e7 03 15 00 00 00 01 00 02 e8 b4 15 00 00 00 01 00 02 e9 03 15 00 00 00 01 00 02 ea d1 15 00 00 00 01 00 02 eb 03 15 00 00 00 01 00 02 ec f0 15 00 00 00 01 00 02 ed 03 15 01 00 00 01 00 02 ee ff 15 00 00 00 01 00 02 ef 00 15 00 00 00 01 00 02 f0 00 15 00 00 00 01 00 02 f1 00 15 00 00 00 01 00 02 f2 0e 15 00 00 00 01 00 02 f3 00 15 00 00 00 01 00 02 f4 28 15 00 00 00 01 00 02 f5 00 15 00 00 00 01 00 02 f6 3b 15 00 00 00 01 00 02 f7 00 15 00 00 00 01 00 02 f8 50 15 00 00 00 01 00 02 f9 00 15 00 00 00 01 00 02 fa 61 15 00 00 00 01 00 02 fb 01 15 01 00 00 01 00 02 ff 21 15 00 00 00 01 00 02 00 00 15 00 00 00 01 00 02 01 72 15 00 00 00 01 00 02 02 00 15 00 00 00 01 00 02 03 82 15 00 00 00 01 00 02 04 00 15 00 00 00 01 00 02 05 91 15 00 00 00 01 00 02 06 00 15 00 00 00 01 00 02 07 c4 15 00 00 00 01 00 02 08 00 15 00 00 00 01 00 02 09 ee 15 00 00 00 01 00 02 0a 01 15 00 00 00 01 00 02 0b 35 15 00 00 00 01 00 02 0c 01 15 00 00 00 01 00 02 0d 6b 15 00 00 00 01 00 02 0e 01 15 00 00 00 01 00 02 0f b6 15 00 00 00 01 00 02 10 01 15 00 00 00 01 00 02 11 f4 15 00 00 00 01 00 02 12 01 15 00 00 00 01 00 02 13 f5 15 00 00 00 01 00 02 14 02 15 00 00 00 01 00 02 15 2d 15 00 00 00 01 00 02 16 02 15 00 00 00 01 00 02 17 6e 15 00 00 00 01 00 02 18 02 15 00 00 00 01 00 02 19 9c 15 00 00 00 01 00 02 1a 02 15 00 00 00 01 00 02 1b d6 15 00 00 00 01 00 02 1c 03 15 00 00 00 01 00 02 1d 04 15 00 00 00 01 00 02 1e 03 15 00 00 00 01 00 02 1f 42 15 00 00 00 01 00 02 20 03 15 00 00 00 01 00 02 21 54 15 00 00 00 01 00 02 22 03 15 00 00 00 01 00 02 23 69 15 00 00 00 01 00 02 24 03 15 00 00 00 01 00 02 25 80 15 00 00 00 01 00 02 26 03 15 00 00 00 01 00 02 27 97 15 00 00 00 01 00 02 28 03 15 00 00 00 01 00 02 29 b2 15 00 00 00 01 00 02 2a 03 15 00 00 00 01 00 02 2b cf 15 00 00 00 01 00 02 2d 03 15 00 00 00 01 00 02 2f f0 15 00 00 00 01 00 02 30 03 15 01 00 00 01 00 02 31 ff 15 00 00 00 01 00 02 32 00 15 00 00 00 01 00 02 33 4a 15 00 00 00 01 00 02 34 00 15 00 00 00 01 00 02 35 57 15 00 00 00 01 00 02 36 00 15 00 00 00 01 00 02 37 6e 15 00 00 00 01 00 02 38 00 15 00 00 00 01 00 02 39 7f 15 00 00 00 01 00 02 3a 00 15 00 00 00 01 00 02 3b 90 15 00 00 00 01 00 02 3d 00 15 00 00 00 01 00 02 3f 9f 15 00 00 00 01 00 02 40 00 15 00 00 00 01 00 02 41 ae 15 00 00 00 01 00 02 42 00 15 00 00 00 01 00 02 43 bb 15 00 00 00 01 00 02 44 00 15 00 00 00 01 00 02 45 c7 15 00 00 00 01 00 02 46 00 15 00 00 00 01 00 02 47 ef 15 00 00 00 01 00 02 48 01 15 00 00 00 01 00 02 49 0e 15 00 00 00 01 00 02 4a 01 15 00 00 00 01 00 02 4b 40 15 00 00 00 01 00 02 4c 01 15 00 00 00 01 00 02 4d 6b 15 00 00 00 01 00 02 4e 01 15 00 00 00 01 00 02 4f b6 15 00 00 00 01 00 02 50 01 15 00 00 00 01 00 02 51 f4 15 00 00 00 01 00 02 52 01 15 00 00 00 01 00 02 53 f5 15 00 00 00 01 00 02 54 02 15 00 00 00 01 00 02 55 2d 15 00 00 00 01 00 02 56 02 15 00 00 00 01 00 02 58 6e 15 00 00 00 01 00 02 59 02 15 00 00 00 01 00 02 5a 9c 15 00 00 00 01 00 02 5b 02 15 00 00 00 01 00 02 5c d6 15 00 00 00 01 00 02 5d 03 15 00 00 00 01 00 02 5e 04 15 00 00 00 01 00 02 5f 03 15 00 00 00 01 00 02 60 42 15 00 00 00 01 00 02 61 03 15 00 00 00 01 00 02 62 54 15 00 00 00 01 00 02 63 03 15 00 00 00 01 00 02 64 69 15 00 00 00 01 00 02 65 03 15 00 00 00 01 00 02 66 80 15 00 00 00 01 00 02 67 03 15 00 00 00 01 00 02 68 97 15 00 00 00 01 00 02 69 03 15 00 00 00 01 00 02 6a b2 15 00 00 00 01 00 02 6b 03 15 00 00 00 01 00 02 6c cf 15 00 00 00 01 00 02 6d 03 15 00 00 00 01 00 02 6e f0 15 00 00 00 01 00 02 6f 03 15 01 00 00 01 00 02 70 ff 15 00 00 00 01 00 02 71 00 15 00 00 00 01 00 02 72 17 15 00 00 00 01 00 02 73 00 15 00 00 00 01 00 02 74 22 15 00 00 00 01 00 02 75 00 15 00 00 00 01 00 02 76 39 15 00 00 00 01 00 02 77 00 15 00 00 00 01 00 02 78 4b 15 00 00 00 01 00 02 79 00 15 00 00 00 01 00 02 7a 5f 15 00 00 00 01 00 02 7b 00 15 00 00 00 01 00 02 7c 6f 15 00 00 00 01 00 02 7d 00 15 00 00 00 01 00 02 7e 7e 15 00 00 00 01 00 02 7f 00 15 00 00 00 01 00 02 80 8c 15 00 00 00 01 00 02 81 00 15 00 00 00 01 00 02 82 9b 15 00 00 00 01 00 02 83 00 15 00 00 00 01 00 02 84 cb 15 00 00 00 01 00 02 85 00 15 00 00 00 01 00 02 86 f5 15 00 00 00 01 00 02 87 01 15 00 00 00 01 00 02 88 3a 15 00 00 00 01 00 02 89 01 15 00 00 00 01 00 02 8a 6f 15 00 00 00 01 00 02 8b 01 15 00 00 00 01 00 02 8c b9 15 00 00 00 01 00 02 8d 01 15 00 00 00 01 00 02 8e f6 15 00 00 00 01 00 02 8f 01 15 00 00 00 01 00 02 90 f7 15 00 00 00 01 00 02 91 02 15 00 00 00 01 00 02 92 2f 15 00 00 00 01 00 02 93 02 15 00 00 00 01 00 02 94 70 15 00 00 00 01 00 02 95 02 15 00 00 00 01 00 02 96 9f 15 00 00 00 01 00 02 97 02 15 00 00 00 01 00 02 98 e0 15 00 00 00 01 00 02 99 03 15 00 00 00 01 00 02 9a 06 15 00 00 00 01 00 02 9b 03 15 00 00 00 01 00 02 9c 38 15 00 00 00 01 00 02 9d 03 15 00 00 00 01 00 02 9e 4b 15 00 00 00 01 00 02 9f 03 15 00 00 00 01 00 02 a0 60 15 00 00 00 01 00 02 a2 03 15 00 00 00 01 00 02 a3 78 15 00 00 00 01 00 02 a4 03 15 00 00 00 01 00 02 a5 90 15 00 00 00 01 00 02 a6 03 15 00 00 00 01 00 02 a7 ac 15 00 00 00 01 00 02 a9 03 15 00 00 00 01 00 02 aa cc 15 00 00 00 01 00 02 ab 03 15 00 00 00 01 00 02 ac ee 15 00 00 00 01 00 02 ad 03 15 01 00 00 01 00 02 ae ff 15 00 00 00 01 00 02 af 00 15 00 00 00 01 00 02 b0 60 15 00 00 00 01 00 02 b1 00 15 00 00 00 01 00 02 b2 69 15 00 00 00 01 00 02 b3 00 15 00 00 00 01 00 02 b4 7d 15 00 00 00 01 00 02 b5 00 15 00 00 00 01 00 02 b6 8d 15 00 00 00 01 00 02 b7 00 15 00 00 00 01 00 02 b8 9e 15 00 00 00 01 00 02 b9 00 15 00 00 00 01 00 02 ba ac 15 00 00 00 01 00 02 bb 00 15 00 00 00 01 00 02 bc b9 15 00 00 00 01 00 02 bd 00 15 00 00 00 01 00 02 be c4 15 00 00 00 01 00 02 bf 00 15 00 00 00 01 00 02 c0 d0 15 00 00 00 01 00 02 c1 00 15 00 00 00 01 00 02 c2 f5 15 00 00 00 01 00 02 c3 01 15 00 00 00 01 00 02 c4 14 15 00 00 00 01 00 02 c5 01 15 00 00 00 01 00 02 c6 45 15 00 00 00 01 00 02 c7 01 15 00 00 00 01 00 02 c8 6f 15 00 00 00 01 00 02 c9 01 15 00 00 00 01 00 02 ca b9 15 00 00 00 01 00 02 cb 01 15 00 00 00 01 00 02 cc f6 15 00 00 00 01 00 02 cd 01 15 00 00 00 01 00 02 ce f7 15 00 00 00 01 00 02 cf 02 15 00 00 00 01 00 02 d0 2f 15 00 00 00 01 00 02 d1 02 15 00 00 00 01 00 02 d2 70 15 00 00 00 01 00 02 d3 02 15 00 00 00 01 00 02 d4 9f 15 00 00 00 01 00 02 d5 02 15 00 00 00 01 00 02 d6 e0 15 00 00 00 01 00 02 d7 03 15 00 00 00 01 00 02 d8 06 15 00 00 00 01 00 02 d9 03 15 00 00 00 01 00 02 da 38 15 00 00 00 01 00 02 db 03 15 00 00 00 01 00 02 dc 4b 15 00 00 00 01 00 02 dd 03 15 00 00 00 01 00 02 de 60 15 00 00 00 01 00 02 df 03 15 00 00 00 01 00 02 e0 78 15 00 00 00 01 00 02 e1 03 15 00 00 00 01 00 02 e2 90 15 00 00 00 01 00 02 e3 03 15 00 00 00 01 00 02 e4 ac 15 00 00 00 01 00 02 e5 03 15 00 00 00 01 00 02 e6 cc 15 00 00 00 01 00 02 e7 03 15 00 00 00 01 00 02 e8 ee 15 00 00 00 01 00 02 e9 03 15 01 00 00 01 00 02 ea ff 15 00 00 00 01 00 02 eb 30 15 00 00 00 01 00 02 ec 17 15 00 00 00 01 00 02 ed 20 15 00 00 00 01 00 02 ee 0f 15 00 00 00 01 00 02 ef 1f 15 00 00 00 01 00 02 f0 0f 15 00 00 00 01 00 02 f1 0f 15 00 00 00 01 00 02 f2 07 15 00 00 00 01 00 02 fb 01 15 01 00 00 01 00 02 ff 10];
		qcom,mdss-dsi-dispparam-cold-command-state = "dsi_hs_mode";
		qcom,mdss-dsi-dispparam-cabcon-command_GUI = [15 00 00 00 01 00 02 ff 10 15 01 00 00 01 00 02 55 81];
		qcom,mdss-dsi-dispparam-cabcon-command_STILL = [15 00 00 00 01 00 02 ff 10 15 01 00 00 01 00 02 55 82];
		qcom,mdss-dsi-dispparam-cabcon-command_MOVIE = [15 00 00 00 01 00 02 ff 10 15 01 00 00 01 00 02 55 83];
		qcom,mdss-dsi-dispparam-cabcon-command-state = "dsi_hs_mode";
		qcom,mdss-dsi-dispparam-cabcoff-command = [15 00 00 00 01 00 02 ff 10 15 01 00 00 01 00 02 55 80];
		qcom,mdss-dsi-dispparam-cabcoff-command-state = "dsi_hs_mode";
	};
};
