/* Copyright (c) 2014, The Linux Foundation. All rights reserved.
 *
 * This program is free software; you can redistribute it and/or modify
 * it under the terms of the GNU General Public License version 2 and
 * only version 2 as published by the Free Software Foundation.
 *
 * This program is distributed in the hope that it will be useful,
 * but WITHOUT ANY WARRANTY; without even the implied warranty of
 * MERCHANTABILITY or FITNESS FOR A PARTICULAR PURPOSE.  See the
 * GNU General Public License for more details.
 */
/*---------------------------------------------------------------------------
 * This file is autogenerated file using gcdb parser. Please do not edit it.
 * Update input XML file to add a new entry or update variable in this file
 * VERSION = "1.0"
*---------------------------------------------------------------------------*/
&mdss_mdp {
	dsi_sharp_nt35595_1080_vid: qcom,mdss_dsi_sharp_nt35595_1080p_video {
		qcom,mdss-dsi-panel-name = "sharp nt35595 1080p video mode dsi panel";
		qcom,mdss-dsi-panel-id = <0x4>;
		qcom,mdss-dsi-panel-controller = <&mdss_dsi0>;
		qcom,mdss-dsi-panel-type = "dsi_video_mode";
		qcom,mdss-dsi-panel-destination = "display_1";
		qcom,mdss-dsi-panel-framerate = <0x3c>;
		qcom,mdss-dsi-virtual-channel-id = <0x0>;
		qcom,mdss-dsi-stream = <0x0>;
		qcom,mdss-dsi-panel-width = <0x438>;
		qcom,mdss-dsi-panel-height = <0x780>;
		qcom,mdss-dsi-h-front-porch = <0x66>;
		qcom,mdss-dsi-h-back-porch = <0x30>;
		qcom,mdss-dsi-h-pulse-width = <0xc>;
		qcom,mdss-dsi-h-sync-skew = <0x0>;
		qcom,mdss-dsi-v-back-porch = <0x5>;
		qcom,mdss-dsi-v-front-porch = <0x4>;
		qcom,mdss-dsi-v-pulse-width = <0x2>;
		qcom,mdss-dsi-h-left-border = <0x0>;
		qcom,mdss-dsi-h-right-border = <0x0>;
		qcom,mdss-dsi-v-top-border = <0x0>;
		qcom,mdss-dsi-v-bottom-border = <0x0>;
		qcom,mdss-dsi-bpp = <0x18>;
		qcom,mdss-dsi-underflow-color = <0xff>;
		qcom,mdss-dsi-border-color = <0x0>;
		qcom,mdss-dsi-pixel-packing = "tight";
		qcom,mdss-dsi-on-command = [15 00 00 00 01 00 02 ff 10 15 00 00 00 01 00 02 bb 03 15 00 00 00 01 00 02 b0 03 39 00 00 00 01 00 06 3b 03 06 04 3c 66 39 00 00 00 01 00 03 44 00 00 15 00 00 00 01 00 02 ff 24 15 00 00 00 01 00 02 c4 69 15 00 00 00 01 00 02 c9 00 15 00 00 00 01 00 02 fb 01 15 00 00 00 01 00 02 ff 10 15 01 00 00 01 00 02 34 00 05 01 00 00 78 00 02 11 00 15 00 00 00 01 00 02 51 ff 15 00 00 00 01 00 02 53 2c 15 00 00 00 01 00 02 55 81 15 00 00 00 01 00 02 ff f0 15 00 00 00 01 00 02 92 01 15 00 00 00 01 00 02 13 01 15 00 00 00 01 00 02 ff 22 15 00 00 00 01 00 02 54 01 15 00 00 00 01 00 02 56 00 15 00 00 00 01 00 02 fb 01 15 01 00 00 01 00 02 ff 10 05 01 00 00 28 00 02 29 00];
		qcom,mdss-dsi-off-command = <0x15010000 0x2ff 0x10390100 0x110002 0x28003901 0x4400 0x2100015 0x1000009 0x24f01>;
		qcom,mdss-dsi-on-command-state = "dsi_lp_mode";
		qcom,mdss-dsi-off-command-state = "dsi_lp_mode";
		qcom,mdss-dsi-h-sync-pulse = <0x0>;
		qcom,mdss-dsi-traffic-mode = "non_burst_sync_pulse";
		qcom,mdss-dsi-bllp-eof-power-mode;
		qcom,mdss-dsi-bllp-power-mode;
		qcom,mdss-dsi-lane-0-state;
		qcom,mdss-dsi-lane-1-state;
		qcom,mdss-dsi-lane-2-state;
		qcom,mdss-dsi-lane-3-state;
		qcom,mdss-dsi-lp11-init;
		qcom,mdss-dsi-panel-timings = <0xe04a3600 0xa9aa2b4e 0x3c030400>;
		qcom,mdss-dsi-t-clk-post = <0x19>;
		qcom,mdss-dsi-t-clk-pre = <0x2f>;
		qcom,mdss-dsi-bl-min-level = <0x1>;
		qcom,mdss-dsi-bl-max-level = <0xff>;
		qcom,mdss-dsi-dma-trigger = "trigger_sw";
		qcom,mdss-dsi-mdp-trigger = "none";
		qcom,mdss-dsi-bl-pmic-control-type = "bl_ctrl_sic";
		qcom,mdss-dsi-reset-sequence = <0x1 0xf 0x0 0x5 0x1 0xa>;
		qcom,mdss-pan-physical-width-dimension = <0x3d>;
		qcom,mdss-pan-physical-height-dimension = <0x6d>;
		qcom,cont-splash-enabled;
		qcom,dispparam-enabled;
		qcom,mdss-dsi-dispparam-ceon-command;
		qcom,mdss-dsi-dispparam-ceon-command-state = "dsi_hs_mode";
		qcom,mdss-dsi-dispparam-ceoff-command = [15 01 00 00 10 00 02 55 01];
		qcom,mdss-dsi-dispparam-ceoff-command-state = "dsi_hs_mode";
		qcom,mdss-dsi-dispparam-warm-command;
		qcom,mdss-dsi-dispparam-warm-command-state = "dsi_hs_mode";
		qcom,mdss-dsi-dispparam-default-command = [15 00 00 00 01 00 02 ff 20 15 00 00 00 01 00 02 fb 00 15 00 00 00 01 00 02 ff 21 15 00 00 00 01 00 02 fb 00 15 00 00 00 01 00 02 ff 10 05 01 00 00 10 00 02 11 00];
		qcom,mdss-dsi-dispparam-default-command-state = "dsi_hs_mode";
		qcom,mdss-dsi-dispparam-cold-command;
		qcom,mdss-dsi-dispparam-cold-command-state = "dsi_hs_mode";
		qcom,mdss-dsi-dispparam-cabcon-command_GUI;
		qcom,mdss-dsi-dispparam-cabcon-command_STILL;
		qcom,mdss-dsi-dispparam-cabcon-command_MOVIE;
		qcom,mdss-dsi-dispparam-cabcon-command-state = "dsi_hs_mode";
		qcom,mdss-dsi-dispparam-cabcoff-command;
		qcom,mdss-dsi-dispparam-cabcoff-command-state = "dsi_hs_mode";
	};
};
