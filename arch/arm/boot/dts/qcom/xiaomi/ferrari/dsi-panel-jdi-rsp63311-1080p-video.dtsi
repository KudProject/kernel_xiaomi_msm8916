/* Copyright (c) 2014, The Linux Foundation. All rights reserved.
 *
 * This program is free software; you can redistribute it and/or modify
 * it under the terms of the GNU General Public License version 2 and
 * only version 2 as published by the Free Software Foundation.
 *
 * This program is distributed in the hope that it will be useful,
 * but WITHOUT ANY WARRANTY; without even the implied warranty of
 * MERCHANTABILITY or FITNESS FOR A PARTICULAR PURPOSE.  See the
 * GNU General Public License for more details.
 */
/*---------------------------------------------------------------------------
 * This file is autogenerated file using gcdb parser. Please do not edit it.
 * Update input XML file to add a new entry or update variable in this file
 * VERSION = "1.0"
*---------------------------------------------------------------------------*/
&mdss_mdp {
	dsi_jdi_rsp63311_1080_vid: qcom,mdss_dsi_jdi_rsp63311_1080p_video {
		qcom,mdss-dsi-panel-name = "jdi rsp63311 1080p video mode dsi panel";
		qcom,mdss-dsi-panel-id = <0x9>;
		qcom,mdss-dsi-panel-controller = <&mdss_dsi0>;
		qcom,mdss-dsi-panel-type = "dsi_video_mode";
		qcom,mdss-dsi-panel-destination = "display_1";
		qcom,mdss-dsi-panel-framerate = <0x3c>;
		qcom,mdss-dsi-virtual-channel-id = <0x0>;
		qcom,mdss-dsi-stream = <0x0>;
		qcom,mdss-dsi-panel-width = <0x438>;
		qcom,mdss-dsi-panel-height = <0x780>;
		qcom,mdss-dsi-h-front-porch = <0x64>;
		qcom,mdss-dsi-h-back-porch = <0x32>;
		qcom,mdss-dsi-h-pulse-width = <0xa>;
		qcom,mdss-dsi-h-sync-skew = <0x0>;
		qcom,mdss-dsi-v-back-porch = <0x3>;
		qcom,mdss-dsi-v-front-porch = <0x4>;
		qcom,mdss-dsi-v-pulse-width = <0x2>;
		qcom,mdss-dsi-h-left-border = <0x0>;
		qcom,mdss-dsi-h-right-border = <0x0>;
		qcom,mdss-dsi-v-top-border = <0x0>;
		qcom,mdss-dsi-v-bottom-border = <0x0>;
		qcom,mdss-dsi-bpp = <0x18>;
		qcom,mdss-dsi-underflow-color = <0xff>;
		qcom,mdss-dsi-border-color = <0x0>;
		qcom,mdss-dsi-pixel-packing = "tight";
		qcom,mdss-dsi-pan-enable-dynamic-fps;
		qcom,mdss-dsi-pan-fps-update = "dfps_immediate_porch_mode";
		qcom,mdss-dsi-min-refresh-rate = <0x2d>;
		qcom,mdss-dsi-max-refresh-rate = <0x3c>;
		qcom,mdss-dsi-on-command = [15 01 00 00 01 00 02 34 00 39 01 00 00 01 00 03 51 0f d7 15 01 00 00 01 00 02 53 2c 15 01 00 00 01 00 02 55 01 05 01 00 00 14 00 02 29 00 05 01 00 00 78 00 02 11 00];
		qcom,mdss-dsi-off-command = <0x5010000 0x14000228 0x50100 0x400002 0x10002301 0x0 0x2b00423 0x1000000 0x2b101>;
		qcom,mdss-dsi-on-command-state = "dsi_lp_mode";
		qcom,mdss-dsi-off-command-state = "dsi_lp_mode";
		qcom,mdss-dsi-h-sync-pulse = <0x0>;
		qcom,mdss-dsi-traffic-mode = "non_burst_sync_pulse";
		qcom,mdss-dsi-bllp-eof-power-mode;
		qcom,mdss-dsi-bllp-power-mode;
		qcom,mdss-dsi-lane-0-state;
		qcom,mdss-dsi-lane-1-state;
		qcom,mdss-dsi-lane-2-state;
		qcom,mdss-dsi-lane-3-state;
		qcom,mdss-dsi-lp11-init;
		qcom,mdss-dsi-panel-timings = <0xe04a3600 0xa9aa2b4e 0x3c030400>;
		qcom,mdss-dsi-t-clk-post = <0x19>;
		qcom,mdss-dsi-t-clk-pre = <0x2f>;
		qcom,mdss-dsi-bl-min-level = <0x1>;
		qcom,mdss-dsi-bl-max-level = <0xff>;
		qcom,mdss-dsi-dma-trigger = "trigger_sw";
		qcom,mdss-dsi-mdp-trigger = "none";
		qcom,mdss-dsi-bl-pmic-control-type = "bl_ctrl_sic";
		qcom,mdss-dsi-reset-sequence = <0x1 0x5 0x0 0x5 0x1 0xa>;
		qcom,mdss-pan-physical-width-dimension = <0x3d>;
		qcom,mdss-pan-physical-height-dimension = <0x6d>;
		qcom,cont-splash-enabled;
		qcom,dispparam-enabled;
		qcom,mdss-dsi-dispparam-ceon-command = [39 01 00 00 21 00 02 00 00 29 01 00 00 00 00 02 b0 04 29 01 00 00 00 00 02 d6 01 29 01 00 00 00 00 02 ca 01 29 01 00 00 00 00 02 b0 03];
		qcom,mdss-dsi-dispparam-ceon-command-state = "dsi_hs_mode";
		qcom,mdss-dsi-dispparam-ceoff-command = [39 01 00 00 21 00 02 00 00 29 01 00 00 00 00 02 b0 04 29 01 00 00 00 00 02 d6 01 29 01 00 00 00 00 02 ca 00 29 01 00 00 00 00 02 b0 03];
		qcom,mdss-dsi-dispparam-ceoff-command-state = "dsi_hs_mode";
		qcom,mdss-dsi-dispparam-warm-command = <0x39010000 0x21000200 0x290100 0x2 0xb0042901 0x0 0x2d60129 0x1000000 0x19c700 0x9111a28 0x41344859 0x686d7706 0xf161e2b 0x41344859 0x686d7729 0x1000000 0x19c821 0x24272b34 0x46364a59 0x646c7724 0x27292d35 0x46364a59 0x646c7729 0x1000000 0x19c92c 0x2e30333a 0x48374c5a 0x656c772e 0x3032353b 0x49374c5a 0x656c7729 0x1000000 0x2b003>;
		qcom,mdss-dsi-dispparam-warm-command-state = "dsi_hs_mode";
		qcom,mdss-dsi-dispparam-default-command = [29 01 00 00 00 00 02 b0 04 29 01 00 00 00 00 02 d6 01 29 01 00 00 00 00 19 c7 00 09 11 1a 28 42 34 48 59 68 6d 77 06 0f 16 1e 2b 42 34 48 59 68 6d 77 29 01 00 00 00 00 19 c8 15 1a 1e 24 2e 44 35 49 58 64 6b 77 19 1d 21 27 30 44 35 49 58 64 6b 77 29 01 00 00 00 00 19 c9 1f 22 25 2a 33 46 35 4a 59 64 6b 77 22 25 28 2c 33 46 36 4a 59 64 6b 77 29 01 00 00 00 00 02 b0 03];
		qcom,mdss-dsi-dispparam-default-command-state = "dsi_hs_mode";
		qcom,mdss-dsi-dispparam-cold-command = <0x39010000 0x21000200 0x290100 0x2 0xb0042901 0x0 0x2d60129 0x1000000 0x19c700 0x9111a28 0x42344959 0x686d7706 0xf161e2b 0x42344859 0x686d7729 0x1000000 0x19c817 0x1b1f252f 0x45354a58 0x636b771b 0x1f222831 0x44354a58 0x636b7729 0x1000000 0x19c919 0x1d212630 0x44354b58 0x646b771d 0x20242932 0x45354a58 0x646b7729 0x1000000 0x2b003>;
		qcom,mdss-dsi-dispparam-cold-command-state = "dsi_hs_mode";
		qcom,mdss-dsi-dispparam-cabcon-command_GUI = [39 01 00 00 00 00 02 55 01];
		qcom,mdss-dsi-dispparam-cabcon-command_STILL;
		qcom,mdss-dsi-dispparam-cabcon-command_MOVIE;
		qcom,mdss-dsi-dispparam-cabcon-command-state = "dsi_hs_mode";
		qcom,mdss-dsi-dispparam-cabcoff-command = [39 01 00 00 00 00 02 55 00];
		qcom,mdss-dsi-dispparam-cabcoff-command-state = "dsi_hs_mode";
	};
};
