/* Copyright (c) 2014-2015, The Linux Foundation. All rights reserved.
 *
 * This program is free software; you can redistribute it and/or modify
 * it under the terms of the GNU General Public License version 2 and
 * only version 2 as published by the Free Software Foundation.
 *
 * This program is distributed in the hope that it will be useful,
 * but WITHOUT ANY WARRANTY; without even the implied warranty of
 * MERCHANTABILITY or FITNESS FOR A PARTICULAR PURPOSE.  See the
 * GNU General Public License for more details.
 */

&soc {
	spmi_bus: qcom,spmi@200f000 {
		qcom,pm8916@0 {
			pm8916_rtc: qcom,pm8916_rtc {
				/* thewisenerd: power-off alarm is broken in android N */
				/* disable alarm pwrup until it is fixed in userspace  */
				qcom,qpnp-rtc-write = <0>;
				qcom,qpnp-rtc-alarm-pwrup = <0>;
			};
		};
	};
};
