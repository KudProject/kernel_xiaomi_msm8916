## drivers/fingerprint/Kconfig
```kconfig
config FINGERPRINT
	tristate "Fingerprint driver support"
	help
	  Say Y here to enable fingerprint driver support!

if FINGERPRINT

config FINGERPRINT_FPC1020
	tristate "FingerPrint Cards fingerprint driver support"

config FINGERPRINT_GOODIX_GF3208
	tristate "Goodix GF3208 fingerprint driver support"

endif # FINGERPRINT
```

## drivers/fingerprint/fpc/Kconfig
```kconfig
config FINGERPRINT_FPC1020
	tristate "FingerPrint Cards fingerprint driver support"
```

## drivers/fingerprint/goodix/Kconfig
```kconfig
config FINGERPRINT_GOODIX_GF3208
	tristate "Goodix GF3208 fingerprint driver support"
```

## drivers/media/platform/msm/camera_ferrari_v2/sensor/flash/lm3646/Kconfig
```kconfig
config MSMB_CAMERA_SENSOR_FLASH_LM3646
	bool "LM3646 Flash sensor support"
	depends on MSMB_CAMERA

config MSMB_CAMERA_SENSOR_FLASH_LM3646_DUMMY
	bool "LM3646 Dummy Driver"
	depends on MSMB_CAMERA_SENSOR_FLASH_LM3646
	---help---
	  Allows control of LM3646 from userspace
```

## drivers/platform/xiaomi/Kconfig
```kconfig
# Xiaomi configuration options

config MACH_XIAOMI
	bool "XIAOMI device"
	depends on ARCH_MSM
	help
	  Support for Xiaomi products

config MACH_XIAOMI_MSM8916
	bool "XIAOMI MSM8916"
	depends on ARCH_MSM8916
	select MACH_XIAOMI
	help
	  Support for MSM8916 Xiaomi variants

menu "Xiaomi board selection"

	config MACH_XIAOMI_IDO
		bool "XIAOMI_IDO board"
		select BATTERY_CW2015
		select BUILD_ARM64_APPENDED_DTB_IMAGE
		select FINGERPRINT
		select FINGERPRINT_FPC1020
		select INPUT_KXTJ9
		select INPUT_LTR559
		select LEDS_AW2013
		select LEDS_TRIGGER_BACKLIGHT
		select MACH_XIAOMI_MSM8916
		select MSM_PRESERVE_MEM
		select QPNP_VM_BMS
		select SENSORS_AKM09911
		select SENSORS_BMA2X2
		select SENSORS_MPU6050
		select SENSORS_STK3X1X
		select SENSORS_YAS537
		select SMB358_CHARGER
		select TOUCHSCREEN_FT5X06
		select TOUCHSCREEN_IST30XX
		help
		  Support for Xiaomi Redmi 3/Pro variant

	config MACH_XIAOMI_FERRARI
		bool "XIAOMI_FERRARI board"
		select BACKLIGHT_LCD_SUPPORT
		select BACKLIGHT_LM3533
		select CM36686
		select HAPTIC_ISA1000
		select IIO
		select IIO_ST_HUB_DRIVERS
		select IIO_ST_HUB_RAM_LOADER
		select IMMERSION_HAPTIC
		select LEDS_LM3533
		select LEDS_TRIGGER_TIMER
		select MACH_XIAOMI_MSM8916
		select MFD_LM3533
		select MSM_PRESERVE_MEM
		select MSMB_CAMERA_SENSOR_FLASH_LM3646
		select MSMB_CAMERA_SENSOR_FLASH_LM3646_DUMMY
		select TOUCHSCREEN_ATMEL_336T
		select XIAOMI_FERRARI_CAMERA
		help
		  Support for Xiaomi Mi 4i variant

endmenu
```
